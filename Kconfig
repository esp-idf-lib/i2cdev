## Kconfig
```kconfig
menu "I2C Device Library"

config I2CDEV_USE_LEGACY_DRIVER
	bool "Use Legacy I2C Driver API"
	default n
	help
		Select this option to use the older ESP-IDF I2C driver API (driver/i2c.h)
		instead of the newer driver API (driver/i2c_master.h).
		
		This is automatically determined by the build system based on your ESP-IDF version.
		For ESP-IDF versions prior to v5.3, the legacy driver will be used automatically.
		You can manually override this setting if needed.

config I2CDEV_AUTO_ENABLE_PULLUPS
	bool "Automatically enable internal I2C pullups when not configured"
	default n
	help
		When enabled, internal pullup resistors are automatically enabled
		when both sda_pullup_en and scl_pullup_en are false (default state).
		
		Useful for development and prototyping. Disable for production 
		systems with external pullups to avoid interference.
		
		Considerations:
		- May increase power consumption slightly
		- Could interfere with carefully tuned external pullups
		- Not recommended for battery-powered applications
		
		Note: This option only affects the modern i2cdev driver (ESP32 family).
		Legacy driver behavior is unchanged for compatibility.

config I2CDEV_DEFAULT_SDA_PIN
	int "Default I2C SDA pin"
	default 21
	help
		Default SDA pin for I2C devices.

config I2CDEV_DEFAULT_SCL_PIN
	int "Default I2C SCL pin"
	default 22
	help
		Default SCL pin for I2C devices.

config I2CDEV_MAX_DEVICES_PER_PORT
	int "Maximum number of devices per I2C port (legacy driver only)"
	default 8
	help
		Maximum number of devices that can be tracked on a single I2C port.
		Used by the legacy driver only: the new i2c_master based driver keeps a
		dynamic list and accepts any number of devices per port.

config I2CDEV_TIMEOUT
    int "I2C transaction timeout, milliseconds"
    default 1000
    range 10 5000
    
config I2CDEV_NOLOCK
	bool "Disable per-device mutexes"
	default n
	help
		Disables the per-device mutex (dev->mutex) and makes
		i2c_dev_take_mutex()/i2c_dev_give_mutex(), as well as the
		I2C_DEV_TAKE_MUTEX/I2C_DEV_GIVE_MUTEX macros, no-ops.

		Bus-level management is not affected: the port mutex, device
		handles and bus teardown in i2cdev_done() still run, so devices
		are removed from the bus and the bus is released as usual.

		Use this option only when all access to each device is already
		serialized by the caller, or when devices must be accessed from
		interrupt context where taking a mutex is not allowed.

endmenu
```
